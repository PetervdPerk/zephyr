## CMakeLists.txt
```
set(BOARD colibri_imx7d_m4)

include($ENV{ZEPHYR_BASE}/cmake/app/boilerplate.cmake NO_POLICY_SCOPE)
project(NONE)

target_include_directories(app PRIVATE $ENV{ZEPHYR_BASE}/samples/subsys/ipc/rpmsg_lite)
target_include_directories(app PRIVATE $ENV{ZEPHYR_BASE}/drivers)
target_include_directories(app PRIVATE $ENV{ZEPHYR_BASE}/ext/lib/ipc/rpmsg_lite/lib/include)
if(CONFIG_SOC_SERIES_LPC54XXX)
target_include_directories(app PRIVATE $ENV{ZEPHYR_BASE}/ext/lib/ipc/rpmsg_lite/lib/include/platform/lpc5411x)
elseif(CONFIG_SOC_SERIES_IMX7_M4)
target_include_directories(app PRIVATE $ENV{ZEPHYR_BASE}/ext/lib/ipc/rpmsg_lite/lib/include/platform/imx7d_m4)
endif()

if(CONFIG_IPC_RPMSG_LITE)
target_sources(app PRIVATE $ENV{ZEPHYR_BASE}/ext/lib/ipc/rpmsg_lite/lib/common/llist.c)
target_sources(app PRIVATE $ENV{ZEPHYR_BASE}/ext/lib/ipc/rpmsg_lite/lib/rpmsg_lite/rpmsg_lite.c)
target_sources(app PRIVATE $ENV{ZEPHYR_BASE}/ext/lib/ipc/rpmsg_lite/lib/rpmsg_lite/rpmsg_ns.c)
target_sources(app PRIVATE $ENV{ZEPHYR_BASE}/ext/lib/ipc/rpmsg_lite/lib/rpmsg_lite/rpmsg_queue.c)
target_sources(app PRIVATE $ENV{ZEPHYR_BASE}/ext/lib/ipc/rpmsg_lite/lib/rpmsg_lite/porting/environment/rpmsg_env_zephyr.c)
if(CONFIG_SOC_SERIES_LPC54XXX)
target_sources(app PRIVATE $ENV{ZEPHYR_BASE}/ext/lib/ipc/rpmsg_lite/lib/rpmsg_lite/porting/platform/lpc5411x/rpmsg_platform_zephyr_ipm.c)
elseif(CONFIG_SOC_SERIES_IMX7_M4)
target_sources(app PRIVATE $ENV{ZEPHYR_BASE}/ext/lib/ipc/rpmsg_lite/lib/rpmsg_lite/porting/platform/imx7d_m4/rpmsg_platform_zephyr_ipm.c)
endif()
target_sources(app PRIVATE $ENV{ZEPHYR_BASE}/ext/lib/ipc/rpmsg_lite/lib/virtio/virtqueue.c)
endif()

target_sources(app PRIVATE src/main_remote_echo.c)
```

## prj.conf
```kconfig
CONFIG_STDOUT_CONSOLE=y
CONFIG_PRINTK=y
CONFIG_IPM=y
CONFIG_IPM_IMX=y
CONFIG_IPM_IMX_MAX_DATA_SIZE_4=y
CONFIG_IPC_RPMSG_LITE=y
CONFIG_HEAP_MEM_POOL_SIZE=16384
CONFIG_GPIO=y
```

## src/main_remote_echo.c
```c
/*
 * Copyright (c) 2018, NXP
 *
 * SPDX-License-Identifier: Apache-2.0
 */

#include <zephyr.h>
#include <misc/printk.h>
#include <device.h>
#include <stdio.h>
#include <stdlib.h>
#include <string.h>
#include "rpmsg_lite.h"
#include "rpmsg_queue.h"
#include "rpmsg_ns.h"
#include <gpio.h>

/* Change this if you have an LED connected to a custom port */
#ifndef LED0_GPIO_CONTROLLER
#define LED0_GPIO_CONTROLLER    LED0_GPIO_PORT
#endif

#define LED_PORT LED0_GPIO_CONTROLLER

/* Change this if you have an LED connected to a custom pin */
#define LED     LED0_GPIO_PIN

#define APP_TASK_STACK_SIZE (1024)
#define LOCAL_EPT_ADDR (30)

#ifdef CONFIG_SOC_SERIES_IMX7_M4
#define RPMSG_LITE_LINK_ID (RL_PLATFORM_IMX7D_M4_LINK_ID)
#define RPMSG_LITE_SHMEM_BASE (0x8FFF0000)
#define RPMSG_LITE_NS_USED (1)
#define RPMSG_LITE_NS_ANNOUNCE_STRING "rpmsg-openamp-demo-channel"
#else
#error Please define ERPC_TRANSPORT_RPMSG_LITE_LINK_ID, RPMSG_LITE_SHMEM_BASE, \
RPMSG_LITE_NS_USED and RPMSG_LITE_NS_ANNOUNCE_STRING values for the CPU used.
#endif

K_THREAD_STACK_DEFINE(thread_stack, APP_TASK_STACK_SIZE);
static struct k_thread thread_data;

void app_nameservice_isr_cb(unsigned int new_ept, const char *new_ept_name,
			    unsigned long flags, void *user_data)
{
}

void app_task(void *arg1, void *arg2, void *arg3)
{
	ARG_UNUSED(arg1);
	ARG_UNUSED(arg2);
	ARG_UNUSED(arg3);
	int recved = 0;
    	char buf[256];
    	char rsp[256];
    	int len;
	volatile unsigned long remote_addr;
	struct rpmsg_lite_endpoint *volatile my_ept;
	volatile rpmsg_queue_handle my_queue;
	struct rpmsg_lite_instance *volatile my_rpmsg;
#ifdef RPMSG_LITE_NS_USED
	volatile rpmsg_ns_handle ns_handle;
#endif /*RPMSG_LITE_NS_USED*/

	struct device *gpio;

        gpio = device_get_binding(LED_PORT);
        /* Set LED pin as output */
        gpio_pin_configure(gpio, LED, GPIO_DIR_OUT);

	my_rpmsg = rpmsg_lite_remote_init((void *)RPMSG_LITE_SHMEM_BASE,
					  RPMSG_LITE_LINK_ID, RL_NO_FLAGS);

	printk("Waiting for Master.\r\n");
	while (!rpmsg_lite_is_link_up(my_rpmsg)) {
	}

	my_queue = rpmsg_queue_create(my_rpmsg);
	my_ept = rpmsg_lite_create_ept(my_rpmsg, LOCAL_EPT_ADDR,
				       rpmsg_queue_rx_cb, my_queue);

#ifdef RPMSG_LITE_NS_USED
	ns_handle = rpmsg_ns_bind(my_rpmsg, app_nameservice_isr_cb, NULL);
	rpmsg_ns_announce(my_rpmsg, my_ept, RPMSG_LITE_NS_ANNOUNCE_STRING,
			  RL_NS_CREATE);
	printk("Nameservice announce sent.\r\n");
#endif /*RPMSG_LITE_NS_USED*/

	while(1)
	{
		rpmsg_queue_recv(my_rpmsg, my_queue, (unsigned long *)&remote_addr, (char*)buf, 256, &recved, RL_BLOCK);
		gpio_pin_write(gpio, LED, 1);
		printk("\nFrom endpoint 0x%X received %d bytes:\n", (unsigned int)remote_addr, recved);
		buf[recved] = 0;
		printk("%s\n",buf);
		len = sprintf(rsp, "echo: %s\n\r",buf);
		printk("Sending %d bytes to endpoint 0x%X:\n", len, (int)remote_addr);
		printk("%s\n",rsp);
		rpmsg_lite_send(my_rpmsg, my_ept, remote_addr, rsp, len, RL_BLOCK);
		gpio_pin_write(gpio, LED, 0);
	}
}

void main(void)
{
	printk("======== rpmsg_lite remote_echo ========\n");

	k_thread_create(&thread_data, thread_stack, APP_TASK_STACK_SIZE,
			(k_thread_entry_t)app_task,
			NULL, NULL, NULL, K_PRIO_COOP(7), 0, 0);
}
```
